## autolinux/configs/autolinux_defconfig
```kconfig
BR2_x86_64=y
BR2_FORCE_HOST_BUILD=y
BR2_KERNEL_HEADERS_5_4=y
BR2_TOOLCHAIN_BUILDROOT_WCHAR=y
BR2_TOOLCHAIN_BUILDROOT_CXX=y
BR2_ROOTFS_DEVICE_CREATION_DYNAMIC_MDEV=y
BR2_ENABLE_LOCALE_WHITELIST="C en_US fr_CH"
BR2_ROOTFS_OVERLAY="$(BR2_EXTERNAL_AUTOLINUX_PATH)/overlay"
BR2_ROOTFS_POST_IMAGE_SCRIPT="$(BR2_EXTERNAL_AUTOLINUX_PATH)/scripts/post_image.sh"
BR2_LINUX_KERNEL=y
BR2_LINUX_KERNEL_USE_ARCH_DEFAULT_CONFIG=y
BR2_LINUX_KERNEL_CUSTOM_LOGO_PATH="$(BR2_EXTERNAL_AUTOLINUX_PATH)/startup.png"
BR2_PACKAGE_BUSYBOX_SHOW_OTHERS=y
BR2_PACKAGE_BUSYBOX_INDIVIDUAL_BINARIES=y
BR2_PACKAGE_BZIP2=y
BR2_PACKAGE_UNZIP=y
BR2_PACKAGE_E2TOOLS=y
BR2_PACKAGE_EXFAT_UTILS=y
BR2_PACKAGE_NFS_UTILS=y
BR2_PACKAGE_NTFS_3G=y
BR2_PACKAGE_NTFS_3G_ENCRYPTED=y
BR2_PACKAGE_NTFS_3G_NTFSPROGS=y
BR2_PACKAGE_XFSPROGS=y
BR2_PACKAGE_HWDATA_IAB_OUI_TXT=y
BR2_PACKAGE_HWDATA_PNP_IDS=y
BR2_PACKAGE_LSHW=y
BR2_PACKAGE_DHCPCD=y
BR2_PACKAGE_WIREGUARD_TOOLS=y
BR2_PACKAGE_BASH=y
BR2_PACKAGE_BASH_COMPLETION=y
BR2_PACKAGE_DIALOG=y
BR2_PACKAGE_SCREEN=y
BR2_PACKAGE_WHICH=y
BR2_PACKAGE_DC3DD=y
BR2_PACKAGE_DDRESCUE=y
BR2_PACKAGE_EFIBOOTMGR=y
BR2_PACKAGE_HTOP=y
BR2_PACKAGE_UTIL_LINUX_BINARIES=y
BR2_TARGET_ROOTFS_CPIO_UIMAGE=y
BR2_TARGET_ROOTFS_EXT2=y
BR2_TARGET_ROOTFS_EXT2_4=y
BR2_TARGET_ROOTFS_EXT2_LABEL="root"
BR2_TARGET_ROOTFS_INITRAMFS=y
BR2_TARGET_ROOTFS_SQUASHFS=y
BR2_TARGET_SYSLINUX=y
```

## autolinux/package/escpr/Config.in
```kconfig
config BR2_PACKAGE_ESCPR
	bool "escpr"
	depends on BR2_PACKAGE_CUPS
	help
	  EPSON injket printers driver
```

## autolinux/package/netdata/Config.in
```kconfig
config BR2_PACKAGE_NETDATA
	bool "netdata"
	depends on BR2_PACKAGE_UTIL_LINUX_LIBUUID

	help
	  netdata
	comment "netdata require libuuid"
	        depends on !BR2_PACKAGE_UTIL_LINUX_LIBUUID
```

## autolinux/package/python-dot3k/Config.in
```kconfig
config BR2_PACKAGE_PYTHON_DOT3K
	bool "python-dot3k"
	depends on BR2_PACKAGE_PYTHON
	help
	  driver for displayotron3000
```

## autolinux/package/python-sn3218/Config.in
```kconfig
config BR2_PACKAGE_PYTHON_SN3218
	bool "python-sn3218"
	depends on BR2_PACKAGE_PYTHON
	help
	  driver for displayotron3000
```

## autolinux/package/python-st7036/Config.in
```kconfig
config BR2_PACKAGE_PYTHON_ST7036
	bool "python-st7036"
	depends on BR2_PACKAGE_PYTHON
	help
	  driver for displayotron3000
```
